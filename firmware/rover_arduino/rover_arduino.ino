/*
  AI Surveillance Rover - Arduino Uno firmware

  The Arduino drives the motors, measures distance with the ultrasonic sensor
  (mounted on the servo), reads GPS, and obeys commands from the Raspberry Pi
  over I2C (address 0x08). It can also be driven by hand over HC-05 Bluetooth.

  Safety built in:
    - every drive command has a duration (max 3 s); the rover stops by itself after it
    - driving forward stops automatically when something is closer than OBSTACLE_CM

  Wiring: see docs/SETUP_GUIDE.md (section 2).
  Library needed: TinyGPSPlus (Arduino IDE > Tools > Manage Libraries > "TinyGPSPlus").
  Unplug the HC-05 TX/RX wires (pins 0/1) while uploading.
*/
#include <Wire.h>
#include <SoftwareSerial.h>
#include <TinyGPSPlus.h>

// ---------------- pins ----------------
const uint8_t ENA = 10, IN1 = 9, IN2 = 8;   // L298N motor A
const uint8_t IN3 = 7, IN4 = 6, ENB = 5;    // L298N motor B
const uint8_t SERVO_PIN = 11;               // SG90 signal (sonar mount)
const uint8_t TRIG_PIN = A1, ECHO_PIN = A2; // HC-SR04
const uint8_t GPS_RX_PIN = 3;               // Arduino receives here  <- GPS TX
const uint8_t GPS_TX_PIN = 2;               // Arduino sends here     -> GPS RX (optional, unused)
const uint8_t I2C_ADDRESS = 0x08;

// ------------- fix directions here after the motor test (guide step 4.3) -------------
const bool SWAP_SIDES = false;    // true if "left" and "right" are the wrong way round
const bool INVERT_A = false;      // true if motor A side turns backwards on "forward"
const bool INVERT_B = false;      // true if motor B side turns backwards on "forward"

// ---------------- behaviour ----------------
const uint16_t OBSTACLE_CM = 25;       // stop forward motion closer than this
const uint16_t MAX_DRIVE_MS = 3000;    // longest single drive command
const uint8_t DEFAULT_SPEED = 160;     // 0-255 (PWM on ENA/ENB)
const uint16_t BT_DRIVE_MS = 300;      // each Bluetooth key press drives this long
const uint8_t SERVO_CENTER = 90;

SoftwareSerial gpsSerial(GPS_RX_PIN, GPS_TX_PIN);
TinyGPSPlus gps;

// ---------------- I2C buffers (filled in interrupts) ----------------
volatile uint8_t rxBuf[4];
volatile bool rxNew = false;
const uint8_t STATUS_LEN = 20;
volatile uint8_t txBuf[STATUS_LEN];

// ---------------- state ----------------
char lastCmd = 'S';
bool moving = false;
bool movingForward = false;
bool obstacleStop = false;
unsigned long moveUntil = 0;
uint16_t distanceCm = 0;              // 0 = nothing in range
unsigned long lastSonar = 0;
uint8_t scanLeft = 0, scanCenter = 0, scanRight = 0;  // in units of 2 cm
uint8_t scanSeq = 0;
bool scanRequested = false;
int lookRequested = -1;
uint8_t btSpeed = DEFAULT_SPEED;

// ======================= motors =======================
void setSide(uint8_t en, uint8_t a, uint8_t b, int speed, bool invert) {
  if (invert) speed = -speed;
  digitalWrite(a, speed > 0 ? HIGH : LOW);
  digitalWrite(b, speed < 0 ? HIGH : LOW);
  analogWrite(en, constrain(abs(speed), 0, 255));
}

void setMotors(int left, int right) {
  if (SWAP_SIDES) { int t = left; left = right; right = t; }
  setSide(ENA, IN1, IN2, left, INVERT_A);
  setSide(ENB, IN3, IN4, right, INVERT_B);
}

void stopMotors() {
  setMotors(0, 0);
  moving = false;
  movingForward = false;
}

void drive(char cmd, uint8_t speed, uint16_t ms) {
  ms = min(ms, MAX_DRIVE_MS);
  lastCmd = cmd;
  if (cmd == 'F' && distanceCm > 0 && distanceCm < OBSTACLE_CM) {   // refuse to hit things
    stopMotors();
    obstacleStop = true;
    return;
  }
  obstacleStop = false;
  switch (cmd) {
    case 'F': setMotors(speed, speed); break;
    case 'B': setMotors(-speed, -speed); break;
    case 'L': setMotors(-speed, speed); break;   // spin left in place
    case 'R': setMotors(speed, -speed); break;   // spin right in place
    default: stopMotors(); return;
  }
  moving = true;
  movingForward = (cmd == 'F');
  moveUntil = millis() + ms;
}

// ======================= sensors =======================
uint16_t readDistanceCm() {
  digitalWrite(TRIG_PIN, LOW);
  delayMicroseconds(2);
  digitalWrite(TRIG_PIN, HIGH);
  delayMicroseconds(10);
  digitalWrite(TRIG_PIN, LOW);
  unsigned long us = pulseIn(ECHO_PIN, HIGH, 25000UL);   // ~4 m max
  return us == 0 ? 0 : us / 58;
}

// Servo pulses are generated by hand (no Servo library), because the Servo
// library would disable PWM on pin 10 (ENA) and break motor speed control.
void servoWrite(uint8_t angle, uint16_t holdMs) {
  uint16_t pulse = map(constrain(angle, 0, 180), 0, 180, 544, 2400);
  unsigned long until = millis() + holdMs;
  while (millis() < until) {
    digitalWrite(SERVO_PIN, HIGH);
    delayMicroseconds(pulse);
    digitalWrite(SERVO_PIN, LOW);
    delay(18);
  }
}

uint8_t to2cm(uint16_t cm) { return cm == 0 ? 255 : (uint8_t)min(cm / 2, 254); }

void sonarScan() {
  stopMotors();
  servoWrite(150, 350); delay(60); scanLeft = to2cm(readDistanceCm());
  servoWrite(SERVO_CENTER, 300); delay(60); scanCenter = to2cm(readDistanceCm());
  servoWrite(30, 350); delay(60); scanRight = to2cm(readDistanceCm());
  servoWrite(SERVO_CENTER, 300);
  scanSeq++;
}

// ======================= I2C =======================
uint8_t checksum(const volatile uint8_t *buf, uint8_t n) {
  uint8_t c = 0xA5;
  for (uint8_t i = 0; i < n; i++) c ^= buf[i];
  return c;
}

void onReceive(int n) {
  uint8_t i = 0;
  while (Wire.available()) {
    uint8_t b = Wire.read();
    if (i < 4) rxBuf[i] = b;
    i++;
  }
  if (i == 4) rxNew = true;   // [cmd, arg1, arg2, checksum]
}

void onRequest() {
  Wire.write((const uint8_t *)txBuf, STATUS_LEN);
}

void handleI2C() {
  if (!rxNew) return;
  noInterrupts();
  uint8_t cmd = rxBuf[0], a = rxBuf[1], b = rxBuf[2], chk = rxBuf[3];
  rxNew = false;
  interrupts();
  uint8_t raw[3] = {cmd, a, b};
  uint8_t c = 0xA5 ^ raw[0] ^ raw[1] ^ raw[2];
  if (c != chk) return;   // corrupted message: ignore
  switch (cmd) {
    case 'F': case 'B': case 'L': case 'R':
      drive((char)cmd, a, (uint16_t)b * 100);   // b = duration in tenths of a second
      break;
    case 'S': stopMotors(); lastCmd = 'S'; break;
    case 'C': scanRequested = true; break;
    case 'V': lookRequested = a; break;
    default: break;   // 'P' (ping) and unknown commands
  }
}

void updateStatus() {
  uint8_t s[STATUS_LEN];
  s[0] = 0xA5;
  s[1] = distanceCm & 0xFF;
  s[2] = distanceCm >> 8;
  bool fix = gps.location.isValid() && gps.location.age() < 5000;
  s[3] = (moving ? 1 : 0) | (obstacleStop ? 2 : 0) | (fix ? 4 : 0);
  s[4] = lastCmd;
  s[5] = scanLeft; s[6] = scanCenter; s[7] = scanRight;
  long lat = fix ? (long)(gps.location.lat() * 1e6) : 0;
  long lng = fix ? (long)(gps.location.lng() * 1e6) : 0;
  for (uint8_t i = 0; i < 4; i++) { s[8 + i] = (lat >> (8 * i)) & 0xFF; s[12 + i] = (lng >> (8 * i)) & 0xFF; }
  s[16] = gps.satellites.isValid() ? (uint8_t)min(gps.satellites.value(), 255UL) : 0;
  s[17] = scanSeq;
  s[18] = 0;
  s[19] = checksum(s, STATUS_LEN - 1);
  noInterrupts();
  for (uint8_t i = 0; i < STATUS_LEN; i++) txBuf[i] = s[i];
  interrupts();
}

// ======================= Bluetooth (HC-05) =======================
// Works with "Arduino Bluetooth RC Car" style apps: F B L R S, digits 0-9 = speed.
void handleBluetooth() {
  while (Serial.available()) {
    char c = Serial.read();
    if (c >= 'a' && c <= 'z') c -= 32;
    if (c >= '0' && c <= '9') btSpeed = map(c - '0', 0, 9, 80, 255);
    else if (c == 'F' || c == 'B' || c == 'L' || c == 'R') drive(c, btSpeed, BT_DRIVE_MS);
    else if (c == 'S') { stopMotors(); lastCmd = 'S'; }
  }
}

// ======================= main =======================
void setup() {
  pinMode(ENA, OUTPUT); pinMode(IN1, OUTPUT); pinMode(IN2, OUTPUT);
  pinMode(ENB, OUTPUT); pinMode(IN3, OUTPUT); pinMode(IN4, OUTPUT);
  pinMode(SERVO_PIN, OUTPUT);
  pinMode(TRIG_PIN, OUTPUT); pinMode(ECHO_PIN, INPUT);
  stopMotors();

  Serial.begin(9600);       // HC-05 default baud (and USB Serial Monitor)
  gpsSerial.begin(9600);    // NEO-6M default baud
  Wire.begin(I2C_ADDRESS);
  Wire.onReceive(onReceive);
  Wire.onRequest(onRequest);

  servoWrite(SERVO_CENTER, 400);
  updateStatus();
  Serial.println(F("ROVER READY"));
}

void loop() {
  while (gpsSerial.available()) gps.encode(gpsSerial.read());
  handleI2C();
  handleBluetooth();

  if (scanRequested) { scanRequested = false; sonarScan(); }
  if (lookRequested >= 0) { uint8_t a = lookRequested; lookRequested = -1; servoWrite(a, 350); }

  if (millis() - lastSonar >= 60) {
    lastSonar = millis();
    distanceCm = readDistanceCm();
    if (movingForward && distanceCm > 0 && distanceCm < OBSTACLE_CM) {
      stopMotors();
      obstacleStop = true;
    }
  }
  if (moving && (long)(millis() - moveUntil) >= 0) stopMotors();

  updateStatus();
}
